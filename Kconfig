## Kconfig
```kconfig
menu "NET Logging"

	config NET_LOGGING_USE_RINGBUFFER
		bool "Use xRingBuffer as IPC"
		default n
		help
			Use xRingBuffer as IPC.

	config NET_LOGGING_MESSAGE_MAX_LENGTH
		int "Max message length"
		default 256
		help
			Set the maximum message length.
			Note: This is the maximum length of a single log message.
			Make sure to set this value according to your needs.
			For example, if you expect to log large messages, you may want to increase this value.
			Conversely, if you are concerned about memory usage, you may want to decrease this value.

	config NET_LOGGING_BUFFER_SIZE
		int "Buffer size"
		default 1024
		help
			Set the buffer size for logging.
			Note: This is the size of the buffer used for logging messages.
			Make sure to set this value according to your needs.
			For example, if you expect to log large messages, you may want to increase this value.
			Conversely, if you are concerned about memory usage, you may want to decrease this value.

endmenu
```

## components/net-logging/Kconfig.projbuild
```kconfig
menu "NET Logging"

	config WRITE_TO_STDOUT
		bool "Enable write Logging to STDOUT"
		default y
		help
			Enable write Logging to STDOUT.

	config NET_LOGGING_USE_RINGBUFFER
		bool "Use xRingBuffer as IPC"
		default n
		help
			Use xRingBuffer as IPC.

	config ESP_WIFI_SSID
		string "WiFi SSID"
		default "myssid"
		help
			SSID (network name) for the example to connect to.

	config ESP_WIFI_PASSWORD
		string "WiFi Password"
		default "mypassword"
		help
			WiFi password (WPA or WPA2) for the example to use.

	config ESP_MAXIMUM_RETRY
		int "Maximum retry"
		default 5
		help
			Set the Maximum retry to avoid station reconnecting to the AP unlimited when the AP is really inexistent.

	config ENABLE_UDP_LOG
		bool "Use UDP Logging"
		default n
		help
			Use UDP Logging.

	config LOG_UDP_SERVER_IP
		depends on ENABLE_UDP_LOG
		string "[UDP] IP address to send log output"
		default "255.255.255.255"
		help
			IP address to send log output to

	config LOG_UDP_SERVER_PORT
		depends on ENABLE_UDP_LOG
		int "[UDP] Port to send log output" 
		default 6789
		help
			Port to send log output to

	config ENABLE_TCP_LOG
		bool "Use TCP Logging"
		default n
		help
			Use TCP Logging.

	config LOG_TCP_SERVER_IP
		depends on ENABLE_TCP_LOG
		string "[TCP] IP address to send log output"
		default "192.168.10.46"
		help
			IP address to send log output to

	config LOG_TCP_SERVER_PORT
		depends on ENABLE_TCP_LOG
		int "[TCP] Port to send log output" 
		default 8080
		help
			Port to send log output to

	config ENABLE_MQTT_LOG
		bool "Use MQTT Logging"
		default n
		help
			Use MQTT Logging.

	config LOG_MQTT_SERVER_URL
		depends on ENABLE_MQTT_LOG
		string "URL of the mqtt server to connect to"
		default "mqtt://broker.emqx.io:1883"
		help
			URL of the mqtt server to connect to

	config LOG_MQTT_PUB_TOPIC
		depends on ENABLE_MQTT_LOG
		string "Publish Topic"
		default "/esp32/logging"
		help
			Topic of publish

	config ENABLE_HTTP_LOG
		bool "Use HTTP Logging"
		default n
		help
			Use HTTP Logging.

	config LOG_HTTP_SERVER_URL
		depends on ENABLE_HTTP_LOG
		string "URL of the http server to connect to"
		default "http://myhttpserver.local:8000"
		help
			URL of the http server to connect to.

	config ENABLE_SSE_SERVER_LOG
		bool "Use SSE Logging"
		default n
		help
			Use SSE Logging.

	config LOG_SSE_LISTEN_PORT
		depends on ENABLE_SSE_SERVER_LOG
		int "Port to bind the SSE server on"
		default 8080
		help
			Port to bind the SSE server on
endmenu
```
